## Config.in
```kconfig
source "$BR2_EXTERNAL_BR_ASTRO_PATH/package/cfitsio/Config.in"
source "$BR2_EXTERNAL_BR_ASTRO_PATH/package/libnova/Config.in"
source "$BR2_EXTERNAL_BR_ASTRO_PATH/package/libindi/Config.in"
source "$BR2_EXTERNAL_BR_ASTRO_PATH/package/libindi_3rdparty/Config.in"
source "$BR2_EXTERNAL_BR_ASTRO_PATH/package/kstars/Config.in"
```

## package/cfitsio/Config.in
```kconfig
config BR2_PACKAGE_CFITSIO
	bool "cfitsio"
	select BR2_PACKAGE_LIBCURL
	help 
		CFITSIO is a library of C and Fortran subroutines for reading and writing data files in FITS (Flexible Image Transport System) data format. CFITSIO provides simple high-level routines for reading and writing FITS files that insulate the programmer from the internal complexities of the FITS format. CFITSIO also provides many advanced features for manipulating and filtering the information in FITS files.

if BR2_PACKAGE_CFITSIO

config BR2_PACKAGE_CFITSIO_SHARED
	bool "Shared libraries"
	help
		Build as a shared library

config BR2_PACKAGE_CFITSIO_UTILS
	bool "Utilities"
	help
		Install cfitsio CLI utilities as well

endif
```

## package/kstars/Config.in
```kconfig
config BR2_PACKAGE_KSTARS
	bool "kstars"
	depends on BR2_INSTALL_LIBSTDCPP
	depends on BR2_TOOLCHAIN_HAS_THREADS
	depends on BR2_PACKAGE_QT5
	select BR2_PACKAGE_EIGEN
	select BR2_PACKAGE_CFITSIO
	help
		KStars is free, open source, cross-platform Astronomy Software. It provides an accurate graphical simulation of the night sky, from any location on Earth, at any date and time. The display includes up to 100 million stars, 13,000 deep-sky objects,all 8 planets, the Sun and Moon, and thousands of comets, asteroids, supernovae, and satellites. For students and teachers, it supports adjustable simulation speeds in order to view phenomena that happen over long timescales, the KStars Astrocalculator to predict conjunctions, and many common astronomical calculations.
		For the amateur astronomer, it provides an observation planner, a sky calendar tool, and an FOV editor to calculate field of view of equipment and display them. Find out interesting objects in the "What's up Tonight" tool, plot altitude vs. time graphs for any object, print high-quality sky charts, and gain access to lots of information and resources to help you explore the universe! Included with KStars is Ekos astrophotography suite, a complete astrophotography solution that can control all INDI devices including numerous telescopes, CCDs, DSLRs, focusers, filters, and a lot more. Ekos supports highly accurate tracking using online and offline astrometry solver, autofocus and autoguiding capabilities, and capture of single or multiple images using the powerful built in sequence manager.

if !BR2_INSTALL_LIBSTDCPP || !BR2_TOOLCHAIN_HAS_THREADS
comment	"kstars needs a toolchain w/ C++, threads"
endif # !BR2_INSTALL_LIBSTDCPP || !BR2_TOOLCHAIN_HAS_THREADS

if !BR2_PACKAGE_QT5
comment "kstars needs QT5"
endif # !BR2_PACKAGE_QT5

#Optional libraries:
# - libraw
# - libindi
# - wcslib
# - xplanet
# - astrometry.net
# - QT5 data visualization
# - openGL
```

## package/libindi/Config.in
```kconfig
config BR2_PACKAGE_LIBINDI
	bool "libindi"
	depends on BR2_INSTALL_LIBSTDCPP
	depends on BR2_TOOLCHAIN_HAS_THREADS
	select BR2_PACKAGE_LIBNOVA
	select BR2_PACKAGE_CFITSIO
	select BR2_PACKAGE_LIBUSB
	select BR2_PACKAGE_ZLIB
	select BR2_PACKAGE_GSL
	select BR2_PACKAGE_JPEG
	select BR2_PACKAGE_LIBCURL	
	help
		INDI Library provides a framework for control and automation of astronomical instruments.

if !BR2_INSTALL_LIBSTDCPP || !BR2_TOOLCHAIN_HAS_THREADS
comment "libindi needs a toolchain w/ C++, threads"
endif # !BR2_INSTALL_LIBSTDCPP || !BR2_TOOLCHAIN_HAS_THREADS
```

## package/libindi_3rdparty/Config.in
```kconfig
config BR2_PACKAGE_LIBINDI_3RDPARTY
	bool "3rd party drivers"
	depends on BR2_PACKAGE_LIBINDI
	select BR2_PACKAGE_LIBUSB
	
if BR2_PACKAGE_LIBINDI_3RDPARTY

config BR2_PACKAGE_LIBINDI_INDI_EQMOD
	bool "indi-eqmod"

config BR2_PACKAGE_LIBINDI_INDI_ASI
	bool "indi-asi"

config BR2_PACKAGE_LIBINDI_INDI_SSAG
	bool "indi-ssag"

endif # BR2_PACKAGE_LIBINDI_3RDPARTY
```

## package/libnova/Config.in
```kconfig
config BR2_PACKAGE_LIBNOVA
	bool "libnova"
	help
		libnova is a general purpose, double precision, Celestial Mechanics, Astrometry and Astrodynamics library.
```
